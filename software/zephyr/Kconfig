## software/zephyr/boards/others/aethercore_sim/Kconfig.aethercore_sim
```kconfig
# SPDX-License-Identifier: Apache-2.0

config BOARD_AETHERCORE_SIM
	select SOC_AETHERCORE32
```

## software/zephyr/boards/others/aethercore_sim/Kconfig.defconfig
```kconfig
# SPDX-License-Identifier: Apache-2.0

if BOARD_AETHERCORE_SIM

config BUILD_OUTPUT_BIN
	default y

endif # BOARD_AETHERCORE_SIM
```

## software/zephyr/boards/others/aethercore_sim/aethercore_sim_defconfig
```kconfig
# SPDX-License-Identifier: Apache-2.0

CONFIG_CONSOLE=y
CONFIG_SERIAL=y
CONFIG_UART_CONSOLE=y
CONFIG_PRINTK=y
CONFIG_XIP=n
CONFIG_RISCV_PMP=n
```

## software/zephyr/drivers/serial/Kconfig
```kconfig
# SPDX-License-Identifier: Apache-2.0

config UART_AETHERCORE
	bool "AetherCore simulation UART"
	default y
	depends on DT_HAS_ZEPHYR_AETHERCORE_UART_ENABLED
	select SERIAL_HAS_DRIVER
	help
	  Enable the AetherCore simulation UART. The driver provides polling TX/RX
	  and, when CONFIG_UART_INTERRUPT_DRIVEN is enabled, level-sensitive RX
	  interrupts through the platform PLIC.
```

## software/zephyr/dts/bindings/misc/zephyr,aethercore-exit.yaml
```yaml
# SPDX-License-Identifier: Apache-2.0

description: AetherCore simulation exit register

compatible: "zephyr,aethercore-exit"

include: base.yaml

properties:
  reg:
    required: true
```

## software/zephyr/dts/bindings/serial/zephyr,aethercore-uart.yaml
```yaml
# SPDX-License-Identifier: Apache-2.0

description: AetherCore simulation UART

compatible: "zephyr,aethercore-uart"

include: uart-controller.yaml

properties:
  reg:
    required: true

  reg-names:
    required: true
```

## software/zephyr/platform/Kconfig
```kconfig
# SPDX-License-Identifier: Apache-2.0

config AETHERCORE_SIM_EXIT
	bool "AetherCore simulation exit service"
	default y
	depends on DT_HAS_ZEPHYR_AETHERCORE_EXIT_ENABLED
	help
	  Provide a deterministic write to the AetherCoreSimTop exit register after
	  the Zephyr qualification workload reaches a terminal result.
```

## software/zephyr/soc/aethercore/Kconfig
```kconfig
# SPDX-License-Identifier: Apache-2.0

config SOC_FAMILY_AETHERCORE
	select ATOMIC_OPERATIONS_C
	select INCLUDE_RESET_VECTOR
	select RISCV
	select RISCV_PRIVILEGED
	select RISCV_HAS_PLIC

if SOC_FAMILY_AETHERCORE

rsource "*/Kconfig"

endif # SOC_FAMILY_AETHERCORE
```

## software/zephyr/soc/aethercore/Kconfig.soc
```kconfig
# SPDX-License-Identifier: Apache-2.0

config SOC_FAMILY_AETHERCORE
	bool

config SOC_FAMILY
	default "aethercore" if SOC_FAMILY_AETHERCORE

rsource "*/Kconfig.soc"
```

## software/zephyr/soc/aethercore/aethercore32/Kconfig
```kconfig
# SPDX-License-Identifier: Apache-2.0

config SOC_AETHERCORE32
	select RISCV_ISA_RV32I
	select RISCV_ISA_EXT_M
	select RISCV_ISA_EXT_ZICSR
	select RISCV_ISA_EXT_ZIFENCEI
```

## software/zephyr/soc/aethercore/aethercore32/Kconfig.soc
```kconfig
# SPDX-License-Identifier: Apache-2.0

config SOC_AETHERCORE32
	bool
	select SOC_FAMILY_AETHERCORE

config SOC
	default "aethercore32" if SOC_AETHERCORE32
```

## west.yml
```yaml
manifest:
  version: "0.13"

  projects:
    - name: zephyr
      url: https://github.com/zephyrproject-rtos/zephyr
      revision: v3.7.2
      import: true

  self:
    path: minicore
```
