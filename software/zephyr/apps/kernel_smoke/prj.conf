## CMakeLists.txt
```
cmake_minimum_required(VERSION 3.20.0)

find_package(Zephyr REQUIRED HINTS $ENV{ZEPHYR_BASE})
project(aethercore_zephyr_kernel_smoke)

target_sources(app PRIVATE src/main.c)
```

## prj.conf
```kconfig
CONFIG_PRINTK=y
CONFIG_SERIAL=y
CONFIG_CONSOLE=y
CONFIG_UART_CONSOLE=y
CONFIG_UART_AETHERCORE=y
CONFIG_AETHERCORE_SIM_EXIT=y
CONFIG_MULTITHREADING=y
CONFIG_TIMESLICING=n
CONFIG_ASSERT=y
CONFIG_MAIN_STACK_SIZE=2048
CONFIG_SYSTEM_WORKQUEUE_STACK_SIZE=1024

# Keep the Z2 smoke heap bounded instead of consuming every remaining byte of
# the 64 MiB simulated RAM aperture. The generic simulator currently services
# RAM through 64-bit beats, so a heap footer placed at RAM_END - 4 is rejected
# as an eight-byte access even though Zephyr issues a valid aligned word store.
# This fixed pool is ample for the deterministic thread/semaphore workload and
# keeps the board memory map truthful while the generic bus model is hardened.
CONFIG_HEAP_MEM_POOL_SIZE=16384
```

## src/main.c
```c
#include <aethercore/exit.h>

#include <zephyr/kernel.h>
#include <zephyr/sys/printk.h>

#define WORKER_STACK_SIZE 1024
#define WORKER_PRIORITY 1
#define HANDOFF_COUNT 4

K_THREAD_STACK_DEFINE(worker_stack, WORKER_STACK_SIZE);
static struct k_thread worker_thread;
K_SEM_DEFINE(step_sem, 0, 1);
K_SEM_DEFINE(done_sem, 0, 1);

static void worker(void *arg1, void *arg2, void *arg3)
{
	ARG_UNUSED(arg1);
	ARG_UNUSED(arg2);
	ARG_UNUSED(arg3);

	printk("AETHERCORE ZEPHYR WORKER READY\n");

	for (int i = 0; i < HANDOFF_COUNT; ++i) {
		k_sem_take(&step_sem, K_FOREVER);
		printk("AETHERCORE ZEPHYR WORKER step=%d\n", i);
		k_sem_give(&done_sem);
	}
}

int main(void)
{
	printk("AETHERCORE ZEPHYR BOOT\n");

	k_thread_create(&worker_thread,
			worker_stack,
			K_THREAD_STACK_SIZEOF(worker_stack),
			worker,
			NULL,
			NULL,
			NULL,
			K_PRIO_PREEMPT(WORKER_PRIORITY),
			0,
			K_NO_WAIT);

	for (int i = 0; i < HANDOFF_COUNT; ++i) {
		printk("AETHERCORE ZEPHYR MAIN give=%d\n", i);
		k_sem_give(&step_sem);
		k_sleep(K_MSEC(1));
		k_sem_take(&done_sem, K_FOREVER);
	}

	printk("AETHERCORE ZEPHYR PASS handoffs=%d\n", HANDOFF_COUNT);
	aethercore_exit(0U);
}
```
